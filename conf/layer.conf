## conf/layer.conf
```bitbake
# We add conf and classes directory, add to BBPATH
BBPATH := "${BBPATH}:${LAYERDIR}"

# We add packages directory, add to BBFILES
BBFILES := "${BBFILES} ${LAYERDIR}/recipes-*/*/*.bb \
           ${LAYERDIR}/recipes-*/*/*.bbappend"

BBFILE_COLLECTIONS += "smartwsn"
BBFILE_PATTERN_smartwsn := "^${LAYERDIR}/"
BBFILE_PRIORITY_smartwsn := "10"
```

## conf/machine/imx6ulgateway.conf
```bitbake
#@TYPE: Machine
#@NAME: SmartWSN i.MX6UL Gateway
#@SOC: i.MX6UL
#@DESCRIPTION: Machine configuration for SmartWSN i.MX6UL Gateway
#@MAINTAINER: Lauren Post <lauren.post@nxp.com>

MACHINEOVERRIDES =. "mx6:mx6ul:"

include conf/machine/include/imx-base.inc
include conf/machine/include/tune-cortexa7.inc

MACHINE_FEATURES += " pci wifi bluetooth"

KERNEL_DEVICETREE = "imx6ul-gateway.dtb \
                     imx6ul-gateway-emmc.dtb"

UBOOT_SUFFIX = "img"
SPL_BINARY = "SPL"
UBOOT_MAKE_TARGET = ""

UBOOT_CONFIG ??= "${@bb.utils.contains('COMBINED_FEATURES', 'optee', 'sd-optee', 'emmc', d)}"
UBOOT_CONFIG[emmc] = "mx6ul_gateway_emmc_config,sdcard"
UBOOT_CONFIG[mfgtool] = "mx6ul_gateway_config"
UBOOT_CONFIG[sd-optee] = "mx6ul_gateway_optee_config,sdcard"

OPTEE_BIN_EXT = "6ulevk"
```
